## Config.in
```kconfig
source "$BR2_EXTERNAL_THINKPAD600X_PATH/package/openmotif/Config.in"
source "$BR2_EXTERNAL_THINKPAD600X_PATH/package/cde/Config.in"
source "$BR2_EXTERNAL_THINKPAD600X_PATH/package/btop/Config.in"
source "$BR2_EXTERNAL_THINKPAD600X_PATH/package/fastfetch/Config.in"
source "$BR2_EXTERNAL_THINKPAD600X_PATH/package/antiword/Config.in"
source "$BR2_EXTERNAL_THINKPAD600X_PATH/package/neomagic-diag/Config.in"
source "$BR2_EXTERNAL_THINKPAD600X_PATH/package/xf86-input-mouse/Config.in"
source "$BR2_EXTERNAL_THINKPAD600X_PATH/package/xf86-input-keyboard/Config.in"
```

## package/antiword/Config.in
```kconfig
config BR2_PACKAGE_ANTIWORD
	bool "antiword"
	help
	  antiword — MS Word .doc to text/PostScript/PDF converter.
```

## package/aquarium/Config.in
```kconfig
config BR2_PACKAGE_AQUARIUM
	bool "aquarium"
	select BR2_PACKAGE_NCURSES
	help
	  Small native ASCII aquarium (fish, bubbles, seaweed) written in C.
	  A lightweight replacement for the Perl "asciiquarium": ncurses only,
	  no floating point / SSE, tuned for the ThinkPad 600X (Pentium III).
```

## package/btop/Config.in
```kconfig
config BR2_PACKAGE_BTOP
	bool "btop"
	depends on BR2_TOOLCHAIN_GCC_AT_LEAST_14
	depends on BR2_INSTALL_LIBSTDCPP
	help
	  btop — resource monitor TUI (C++). Requires C++23-capable gcc.
```

## package/cde/Config.in
```kconfig
config BR2_PACKAGE_CDE
	bool "cde (Common Desktop Environment)"
	depends on BR2_PACKAGE_XORG7
	depends on BR2_PACKAGE_OPENMOTIF
	select BR2_PACKAGE_LIBTIRPC
	select BR2_PACKAGE_LMDB
	select BR2_PACKAGE_MKSH
	select BR2_PACKAGE_JPEG
	select BR2_PACKAGE_OPENSSL
	select BR2_PACKAGE_XLIB_LIBX11
	select BR2_PACKAGE_XLIB_LIBXT
	select BR2_PACKAGE_XLIB_LIBXEXT
	select BR2_PACKAGE_XLIB_LIBXMU
	select BR2_PACKAGE_XLIB_LIBXPM
	select BR2_PACKAGE_XLIB_LIBXRENDER
	select BR2_PACKAGE_XLIB_LIBXFT
	select BR2_PACKAGE_XLIB_LIBXINERAMA
	select BR2_PACKAGE_XLIB_LIBXSCRNSAVER
	select BR2_PACKAGE_XLIB_LIBXAW
	select BR2_PACKAGE_XLIB_LIBXRANDR
	select BR2_PACKAGE_FONTCONFIG
	select BR2_PACKAGE_FREETYPE
	select BR2_PACKAGE_LINUX_PAM
	help
	  Common Desktop Environment 2.5.x — dtwm, dtterm, dtfile, dtpad,
	  dtsession and friends, installed under /usr/dt.
```

## package/cmatrix/Config.in
```kconfig
config BR2_PACKAGE_CMATRIX
	bool "cmatrix"
	select BR2_PACKAGE_NCURSES
	help
	  Terminal "Matrix" effect: falling green characters. Light enough for
	  the Pentium III (uses ncurses, no X).

	  https://github.com/abishekvashok/cmatrix
```

## package/fastfetch/Config.in
```kconfig
config BR2_PACKAGE_FASTFETCH
	bool "fastfetch"
	depends on BR2_TOOLCHAIN_GCC_AT_LEAST_13
	help
	  fastfetch — system information display (C).
```

## package/neomagic-diag/Config.in
```kconfig
config BR2_PACKAGE_NEOMAGIC_DIAG
	bool "neomagic-diag"
	help
	  Standalone diagnostic for the NeoMagic MagicGraph 256ZX (NM2360)
	  BitBLT engine. Maps PCI BAR0 (framebuffer) + BAR1 (MMIO) from
	  userspace and tests solid fill, screen-to-screen blit and ROP,
	  verifying results and timing. Safe: time-bounded wait, no writes
	  outside the documented register block.
```

## package/nyancat/Config.in
```kconfig
config BR2_PACKAGE_NYANCAT
	bool "nyancat"
	select BR2_PACKAGE_NCURSES
	help
	  Nyan Cat in the terminal (ANSI, ncurses). Very light.

	  https://github.com/klange/nyancat
```

## package/openmotif/Config.in
```kconfig
config BR2_PACKAGE_OPENMOTIF
	bool "openmotif"
	depends on BR2_PACKAGE_XORG7
	select BR2_PACKAGE_XLIB_LIBX11
	select BR2_PACKAGE_XLIB_LIBXT
	select BR2_PACKAGE_XLIB_LIBXEXT
	select BR2_PACKAGE_XLIB_LIBXMU
	select BR2_PACKAGE_XLIB_LIBXPM
	select BR2_PACKAGE_XLIB_LIBXRENDER
	select BR2_PACKAGE_XLIB_LIBXFT
	select BR2_PACKAGE_XLIB_LIBXINERAMA
	select BR2_PACKAGE_FONTCONFIG
	select BR2_PACKAGE_FREETYPE
	select BR2_PACKAGE_JPEG
	select BR2_PACKAGE_LIBPNG
	help
	  OpenMotif 2.3 — libXm, libMrm, libUil. Required by CDE and NEdit.
```

## package/xf86-input-keyboard/Config.in
```kconfig
config BR2_PACKAGE_XF86_INPUT_KEYBOARD
	bool "xf86-input-keyboard"
	depends on BR2_PACKAGE_XORG7
	select BR2_PACKAGE_XORGPROTO
	help
	  Classic X.Org keyboard input driver (the console/PS2 keyboard).

	  Same rationale as xf86-input-mouse: no udev in this image, so
	  xf86-input-evdev cannot be selected.
```

## package/xf86-input-mouse/Config.in
```kconfig
config BR2_PACKAGE_XF86_INPUT_MOUSE
	bool "xf86-input-mouse"
	depends on BR2_PACKAGE_XORG7
	select BR2_PACKAGE_XORGPROTO
	help
	  Classic X.Org mouse input driver (PS/2 via /dev/input/mice).

	  Unlike xf86-input-evdev this driver does not require udev, which
	  matters on this image: it uses mdev/devtmpfs and has no udev, so the
	  evdev package cannot be selected (Buildroot guards it with
	  "depends on BR2_PACKAGE_HAS_UDEV").
```
